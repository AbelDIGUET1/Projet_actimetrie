
//---------écran------------//

#include <Adafruit_GFX.h>
#include <Adafruit_ST7789.h>
#include <SPI.h>

// Définir les broches SPI pour l'écran (à adapter si nécessaire)
#define TFT_CS   10
#define TFT_RST  9
#define TFT_DC   8

Adafruit_ST7789 display = Adafruit_ST7789(TFT_CS, TFT_DC, TFT_RST);

//------------écran---------------//

// 'Icone ordi allumé', 50x50px
const unsigned char epd_bitmap_Icone_ordi_allum_ [] PROGMEM = {
  0x00, 0x00, 0x00, 0x00, 0x00, 0x00, 0x00, 0x00, 0x00, 0x00, 0x00, 0x00, 0x00, 0x00, 0x00, 0x00, 
  0x00, 0x00, 0x00, 0x00, 0x00, 0x00, 0x00, 0x00, 0x00, 0x00, 0x00, 0x00, 0x00, 0x00, 0x00, 0x00, 
  0x00, 0x00, 0x00, 0x00, 0x00, 0x00, 0x00, 0x00, 0x00, 0x00, 0x00, 0x00, 0x00, 0x00, 0x00, 0x00, 
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  0x00, 0x00, 0x00, 0x00, 0x00, 0x00, 0x00, 0x00, 0x00, 0x00, 0x00, 0x00, 0x00, 0x00
};


const int epd_bitmap_allArray_LEN1= 1;
const unsigned char* epd_bitmap_allArray1[1] = {
  epd_bitmap_Icone_ordi_allum_
};

// 'Icone ordi éteint', 50x50px
const unsigned char epd_bitmap_Icone_ordi__teint [] PROGMEM = {
  0x00, 0x00, 0x00, 0x00, 0x00, 0x00, 0x00, 0x00, 0x00, 0x00, 0x00, 0x00, 0x00, 0x00, 0x00, 0x00, 
  0x00, 0x00, 0x00, 0x00, 0x00, 0x00, 0x00, 0x00, 0x00, 0x00, 0x00, 0x00, 0x00, 0x00, 0x00, 0x00, 
  0x00, 0x00, 0x00, 0x00, 0x00, 0x00, 0x00, 0x00, 0x00, 0x00, 0x00, 0x00, 0x00, 0x00, 0x00, 0x00, 
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  0x00, 0x00, 0x00, 0x00, 0x00, 0x00, 0x00, 0x00, 0x00, 0x00, 0x00, 0x00, 0x00, 0x00
};

const int epd_bitmap_allArray_LEN2= 1;
const unsigned char* epd_bitmap_allArray2[1] = {
  epd_bitmap_Icone_ordi__teint
};

// 'Icone bluetooth allumé', 50x50px
const unsigned char epd_bitmap_Icone_bluetooth_allum_ [] PROGMEM = {
  0x00, 0x00, 0x00, 0x00, 0x00, 0x00, 0x00, 0x00, 0x00, 0x00, 0x00, 0x00, 0x00, 0x00, 0x00, 0x00, 
  0x00, 0x00, 0x00, 0x00, 0x00, 0x00, 0x00, 0x00, 0x00, 0x00, 0x00, 0x00, 0x00, 0x00, 0x00, 0x00, 
  0x00, 0x00, 0x00, 0x00, 0x00, 0x00, 0x00, 0x00, 0x00, 0x00, 0x00, 0x00, 0x00, 0x00, 0x00, 0x00, 
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  0x00, 0x00, 0x00, 0x00, 0x00, 0x00, 0x00, 0x00, 0x00, 0x00, 0x00, 0x00, 0x00, 0x00
};

const int epd_bitmap_allArray_LEN3 = 1;
const unsigned char* epd_bitmap_allArray3[1] = {
  epd_bitmap_Icone_bluetooth_allum_
};

// 'Icone MEAB', 50x50px
const unsigned char epd_bitmap_Icone_MEAB [] PROGMEM = {
  0x00, 0x00, 0x00, 0x00, 0x00, 0x00, 0x00, 0x00, 0x00, 0x00, 0x00, 0x00, 0x00, 0x00, 0x00, 0x00, 
  0x00, 0x00, 0x00, 0x00, 0x00, 0x00, 0x00, 0x00, 0x00, 0x00, 0x00, 0x00, 0x00, 0x00, 0x00, 0x00, 
  0x00, 0x00, 0x00, 0x00, 0x00, 0x07, 0xfc, 0x00, 0x00, 0x00, 0x00, 0x00, 0x3f, 0xff, 0x80, 0x00, 
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  0x00, 0x00, 0x00, 0x00, 0x00, 0x00, 0x00, 0x00, 0x00, 0x00, 0x00, 0x00, 0x00, 0x00
};


const unsigned char* epd_bitmap_allArray4[1] = {
  epd_bitmap_Icone_MEAB
};

void setup()
{
  Serial.begin(9600);

  // Initialisation de l'écran
  display.init(240, 240); // Initialisation pour un écran 240x240
  display.setRotation(0); // Orientation de l'écran
  display.fillScreen(ST77XX_BLACK); // Efface l'écran en noir
}

void loop() {

  //écran//

  // Variable de mouvement (activité) et batterie (charge)
    float mouvement = 0.7; // Niveau d'activité (0 à 1)
    float batterie = 0.5;  // Niveau de batterie (0 à 1)

    // --- Effacer l'écran avant chaque mise à jour ---
    display.fillScreen(ST77XX_BLACK);

    // --- Affichage de la barre centrale (activité) ---
    // Position et dimensions du rectangle extérieur (blanc)
    int x = 20; // Position X
    int y = 130; // Position Y
    int Lar = 200; // Largeur
    int Hau = 40; // Hauteur Hau
    int arrondi = 10; // Rayon des coins arrondis
    int Ep = 3; // Épaisseur

    // Dessiner le cadre extérieur blanc
    for (int i = 0; i < Ep; i++) {
        display.drawRoundRect(x + i, y + i, Lar - 2 * i, Hau - 2 * i, arrondi, ST77XX_WHITE);
    }

    // Déterminer la largeur de la barre intérieure
    int Lar_int = Lar * mouvement;
    int x_int = x + Ep;
    int y_int = y + Ep;
    int Hau_int = Hau - 2 * Ep;
    int arrondi_inter = 5;

    // Couleur et message pour la barre d'activité
    uint16_t color;
    const char* message;

    if (mouvement <= 0.2) {
        color = ST77XX_RED;
        message = "Bouge !";
    } else if (mouvement <= 0.4) {
        color = ST77XX_ORANGE;
        message = "Insuffisant";
    } else if (mouvement <= 0.6) {
        color = ST77XX_YELLOW;
        message = "Encore";
    } else if (mouvement <= 0.8) {
        color = ST77XX_GREEN;
        message = "C'est bien";
    } else {
        color = 0x03E0; // Vert foncé
        message = "Excellent";
    }

    // Dessiner la barre d'activité
    display.fillRoundRect(x_int, y_int, Lar_int, Hau_int, arrondi_inter, color);

    // Afficher le texte de la barre d'activité
    int16_t text_x, text_y;
    uint16_t text_Lar, text_Hau;
    display.setTextSize(3);
    display.getTextBounds(message, 0, 0, &text_x, &text_y, &text_Lar, &text_Hau);

    int text_x_centre = (240 - text_Lar) / 2;
    int text_y_centre = 190;
    display.setCursor(text_x_centre, text_y_centre);
    display.setTextColor(ST77XX_WHITE);
    display.print(message);

    // --- Affichage de la barre de batterie ---
    int x_bat = 155; // Position X en haut à droite
    int y_bat = 6;  // Position Y en haut
    int Lar_bat = 75; // Largeur
    int Hau_bat = 34; // Hauteur
    int arrondi_bat = 12; // Rayon des coins arrondis
    int Ep_bat = 2; // Épaisseur

    // Dessiner le cadre extérieur blanc pour la batterie
    for (int i = 0; i < Ep_bat; i++) {
        display.drawRoundRect(x_bat + i, y_bat + i, Lar_bat - 2 * i, Hau_bat - 2 * i, arrondi_bat, ST77XX_WHITE);
    }

    // Déterminer la largeur intérieure de la barre de batterie
    int Lar_bat_int = Lar_bat * batterie;
    int x_bat_int = x_bat + Ep_bat;
    int y_bat_int = y_bat + Ep_bat;
    int Hau_bat_int = Hau_bat - 2 * Ep_bat;

    // Couleur de la batterie en fonction de son niveau
    uint16_t battery_color;
    if (batterie <= 0.2) {
        battery_color = ST77XX_RED;
    } else if (batterie <= 0.4) {
        battery_color = ST77XX_ORANGE;
    } else if (batterie <= 0.6) {
        battery_color = ST77XX_YELLOW;
    } else if (batterie <= 0.8) {
        battery_color = ST77XX_GREEN;
    } else {
        battery_color = 0x03E0; // Vert foncé
    }

    // Dessiner la barre de batterie
    display.fillRoundRect(x_bat_int, y_bat_int, Lar_bat_int, Hau_bat_int, arrondi_bat, battery_color);

    display.drawBitmap(0,0,epd_bitmap_Icone_ordi_allum_ ,50,50,ST77XX_WHITE);
    display.drawBitmap(50,0,epd_bitmap_Icone_bluetooth_allum_,50,50,ST77XX_WHITE);
    display.drawBitmap(95,0,epd_bitmap_Icone_MEAB,50,50,0x780F);

    delay(2000);
    
}


